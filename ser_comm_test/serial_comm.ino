/*
program to test serial communication of capstone project
*/
char in_bytes[10] = {0};
const int start_seq = 36;
const int end_seq = 47;
int ttf = 0; // time to fire
int x_coord = 0;
int y_coord = 0;
int z_coord = 0;
int reply = 254;
int count = -32768;

void setup() {
  Serial.begin(9600); 
  pinMode(LED_BUILTIN, OUTPUT);
}

void loop() {
  while (Serial.available()>=10){
    digitalWrite(LED_BUILTIN, HIGH);
    Serial.readBytes(in_bytes,10);
    if (start_seq == (int)in_bytes[0] && end_seq == (int)in_bytes[9]){
      // a packet has been received so read data
      ttf = ((int)in_bytes[1]<<8 & 0xff00) | ((int)in_bytes[2] & 0xff);
      x_coord = ((int)in_bytes[3]<<8 & 0xff00) | ((int)in_bytes[4] & 0xff);
      y_coord = ((int)in_bytes[5]<<8 & 0xff00) | ((int)in_bytes[6] & 0xff);
      z_coord = ((int)in_bytes[7]<<8 & 0xff00) | ((int)in_bytes[8] & 0xff);
      if(z_coord == count){
        reply = 1;
      } else{
        reply = y_coord;
      }
    } else{
      reply = 0;
    }
    int bytes_sent = Serial.write(reply);
    count += 1;
  } 
  digitalWrite(LED_BUILTIN, LOW);
}
